## Kconfig
```kconfig
# ZMK ports of Pascal Getreuer's Select Word, Cyclotab and Orbital Mouse.

config ZMK_BEHAVIOR_SELECT_WORD
    bool "Select Word behavior"
    default y
    depends on DT_HAS_ZMK_BEHAVIOR_SELECT_WORD_ENABLED

config ZMK_BEHAVIOR_CYCLOTAB
    bool "Cyclotab (Alt+Tab swapper) behavior"
    default y
    depends on DT_HAS_ZMK_BEHAVIOR_CYCLOTAB_ENABLED

config ZMK_BEHAVIOR_ORBITAL_MOUSE
    bool "Orbital Mouse behavior"
    default y
    depends on DT_HAS_ZMK_BEHAVIOR_ORBITAL_MOUSE_ENABLED
    select ZMK_POINTING
```

## dts/bindings/behaviors/zmk,behavior-cyclotab.yaml
```yaml
# Cyclotab behavior (ZMK port of Pascal Getreuer's QMK module).
# https://getreuer.info/posts/keyboards/cyclotab/index.html

description: |
  Alt+Tab (and friends) swapper. Param is a modified keycode such as LA(TAB),
  LS(LA(TAB)), LG(TAB) or LG(GRAVE). The non-Shift modifiers are held after
  the key is released so the hotkey can be tapped repeatedly; Shift is only
  applied to the individual tap. The held modifiers are released when any
  other key is pressed (that key is consumed), when the layer the behavior
  was pressed on is deactivated, or after timeout-ms.

compatible: "zmk,behavior-cyclotab"

include: one_param.yaml

properties:
  timeout-ms:
    type: int
    default: 1000
    description: Release the held modifiers after this many ms of inactivity. 0 disables.
  pass-through:
    type: boolean
    description: |
      If set, the key press that ends the cycle is sent to the host instead of
      being swallowed.
```

## dts/bindings/behaviors/zmk,behavior-orbital-mouse.yaml
```yaml
# Orbital Mouse behavior (ZMK port of Pascal Getreuer's QMK module).
# https://getreuer.info/posts/keyboards/orbital-mouse/index.html

description: |
  Tank-control mouse keys. Param is one of the OM_* codes from
  <dt-bindings/zmk/orbital_mouse.h>. The node must be referenced by a
  zmk,input-listener so its input events reach the HID mouse report.

compatible: "zmk,behavior-orbital-mouse"

include: one_param.yaml

properties:
  speed-curve:
    type: array
    default: [24, 24, 24, 32, 58, 66, 66, 66, 66, 66, 66, 66, 66, 66, 66, 66]
    description: |
      16 speed values (0-255). Entry n is the speed after holding a movement
      key for 0.256*n seconds; values are linearly interpolated in between.
  radius:
    type: int
    default: 36
    description: Orbit radius in pixels when steering. Must be in [0, 63].
  slow-move-percent:
    type: int
    default: 33
    description: Movement speed while OM_SLOW is held, as a percentage (0-99).
  slow-turn-percent:
    type: int
    default: 50
    description: Turning speed while OM_SLOW is held, as a percentage (0-99).
  fast-move-percent:
    type: int
    default: 300
    description: Movement speed while OM_FAST is held, as a percentage (< 1600).
  fast-turn-percent:
    type: int
    default: 200
    description: Turning speed while OM_FAST is held, as a percentage (< 1600).
  wheel-speed-percent:
    type: int
    default: 20
    description: Wheel steps per frame, as a percentage (e.g. 20 = 0.2 steps/frame, < 400).
  dbl-delay-ms:
    type: int
    default: 50
    description: Gap between the two clicks of OM_DBLS.
  interval-ms:
    type: int
    default: 16
    description: Frame interval of the movement task.
```

## dts/bindings/behaviors/zmk,behavior-select-word.yaml
```yaml
# Select Word behavior (ZMK port of Pascal Getreuer's QMK module).
# https://getreuer.info/posts/keyboards/select-word/index.html

description: |
  Smart word / line selection. Param is one of SW_WORD, SW_BACK, SW_LINE,
  SW_LINE_UP from <dt-bindings/zmk/select_word.h>. Pressing repeatedly (or
  holding) extends the selection.

compatible: "zmk,behavior-select-word"

include: one_param.yaml

properties:
  mac:
    type: boolean
    description: Send macOS hotkeys (Alt/Cmd + arrows) instead of Windows/Linux ones.
  timeout-ms:
    type: int
    default: 5000
    description: |
      Idle time after which the internal selection state is forgotten.
      0 disables the timeout.
```
